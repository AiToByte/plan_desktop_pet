## esp32_firmware/sdkconfig.defaults
```kconfig
# Task WDT配置（覆盖ESP-IDF默认值）
# 30秒超时（vs默认5秒），允许WiFi/BLE长任务
CONFIG_ESP_TASK_WDT_TIMEOUT_S=30
# 仅监控idle task（不监控所有任务，避免FreeRTOS任务切换误触发）
CONFIG_ESP_TASK_WDT_CHECK_IDLE_TASK_CPU0=y
CONFIG_ESP_TASK_WDT_CHECK_IDLE_TASK_CPU1=y
CONFIG_ESP_TASK_WDT_PANIC=y

# 启用panic handler打印reset reason
CONFIG_ESP_SYSTEM_PANIC_PRINT_REBOOT=y

# RTC WDT（硬件级，即使软件WDT失败也能复位）
CONFIG_ESP_INT_WDT_TIMEOUT_MS=300
```
